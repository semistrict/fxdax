## guest/linux/drivers/virtio_extent/Kconfig
```kconfig
# SPDX-License-Identifier: GPL-2.0 OR BSD-3-Clause
# Copyright 2026 The fxdax Authors.
config VIRTIO_EXTENT
	tristate "Virtio extent-store device"
	depends on VIRTIO
	help
	  The driver of fxdax's virtio extent-store device, which a guest's Fxfs
	  stores its filesystem through: extents it names, written once and freed
	  whole, a root, and a DAX window that extents map into.
```

## guest/linux/fs/fxfs/Kconfig
```kconfig
# SPDX-License-Identifier: GPL-2.0 OR BSD-3-Clause
# Copyright 2026 The fxdax Authors.
config FXFS_FS
	bool "Fxfs"
	depends on VIRTIO_EXTENT=y
	select MAPPING_DIRTY_HELPERS if FS_DAX
	select GENERIC_ALLOCATOR if FS_DAX
	help
	  Fuchsia's Fxfs, running in the guest kernels of fxdax's virtual machines,
	  on the virtio extent-store device.
	  Its Rust is built outside Kbuild, by fxdax's scripts/build-guest-kernel.sh,
	  which leaves the archive at fs/fxfs/libfxfs_linux.a.
```
